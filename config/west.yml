## config/west.yml
```yaml
manifest:
  remotes:
    - name: zmkfirmware
      url-base: https://github.com/zmkfirmware
    # Additional modules containing boards/shields/custom code can be listed here as well
    # See https://docs.zephyrproject.org/3.2.0/develop/west/manifest.html#projects
    - name: badjeff
      url-base: https://github.com/badjeff
    - name: Cyboard-DigitalTailor
      url-base: https://github.com/Cyboard-DigitalTailor
  projects:
    - name: zmk
      remote: zmkfirmware
      revision: abb64ba
      import: app/west.yml
    - name: zmk-pmw3610-driver
      remote: Cyboard-DigitalTailor
      revision: 187c3e2
  self:
    path: config
```
